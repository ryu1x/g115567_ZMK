#include <dt-bindings/gpio/gpio.h>
#include <dt-bindings/zmk/matrix_transform.h>

/ {
    chosen {
        zmk,kscan = &kscan0;
    };

    kscan0: kscan {
        compatible = "zmk,kscan-gpio-matrix";
        label = "KSCAN";
        diode-direction = "col2row";

        col-gpios
            = <&gpio0 27 (GPIO_ACTIVE_HIGH)>
            , <&gpio0 26 (GPIO_ACTIVE_HIGH)>
            , <&gpio0 25 (GPIO_ACTIVE_HIGH)>
            , <&gpio0 24 (GPIO_ACTIVE_HIGH)>
            , <&gpio0 23 (GPIO_ACTIVE_HIGH)>
            , <&gpio0 22 (GPIO_ACTIVE_HIGH)>
            , <&gpio0 20 (GPIO_ACTIVE_HIGH)>
            , <&gpio0 19 (GPIO_ACTIVE_HIGH)>
            ;

        row-gpios
            = <&gpio0 2 (GPIO_ACTIVE_HIGH | GPIO_PULL_DOWN)>
            , <&gpio0 3 (GPIO_ACTIVE_HIGH | GPIO_PULL_DOWN)>
            , <&gpio0 4 (GPIO_ACTIVE_HIGH | GPIO_PULL_DOWN)>
            , <&gpio0 5 (GPIO_ACTIVE_HIGH | GPIO_PULL_DOWN)>
            , <&gpio0 28 (GPIO_ACTIVE_HIGH | GPIO_PULL_DOWN)>
            ;
    };
};
